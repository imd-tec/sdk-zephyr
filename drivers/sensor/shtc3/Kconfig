## drivers/sensor/shtc3/Kconfig
```kconfig
# Copyright (c) 2020 IMD Technologies
# SPDX-License-Identifier: Apache-2.0

config SHTC3
	bool "SHTC3 Temperature & Humidity Sensor"
	depends on I2C && HAS_DTS_I2C
	help
	  Enable the driver for Sensirion's SHTC3 temperature and humidity sensor
```

## dts/bindings/sensor/sensirion,shtc3.yaml
```yaml
# Copyright (c) 2018, Peter Bigot Consulting, LLC
# SPDX-License-Identifier: Apache-2.0

description: Sensirion SHT3C humidity and temperature sensor

compatible: "sensirion,shtc3"

include: i2c-device.yaml
```
